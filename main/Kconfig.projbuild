## main/Kconfig.projbuild
```kconfig
menu "PrintSpy Cam Configuration"

    choice PRINTSPY_CAM_BOARD
        prompt "Target board"
        default BOARD_FREENOVE_S3

        config BOARD_FREENOVE_S3
            bool "Freenove ESP32-S3 CAM"
            depends on IDF_TARGET_ESP32S3

        config BOARD_NULLLAB_ESP32S3_CAM
            bool "nulllaborg ESP32-S3-CAM"
            depends on IDF_TARGET_ESP32S3

    endchoice

endmenu
```

## sdkconfig.defaults
```kconfig
# Actual filename set per-target in sdkconfig.defaults.esp32(s3) - flash
# size differs enough between boards (4MB vs 8MB) to need separate tables.
CONFIG_PARTITION_TABLE_CUSTOM=y

# Reduce binary size
CONFIG_COMPILER_OPTIMIZATION_SIZE=y
CONFIG_NEWLIB_NANO_FORMAT=y

# Left at INFO (the ESP-IDF default) rather than WARN - suppressing INFO
# blinded us to every ESP_LOGI in our own code (WiFi connect attempts,
# success/failure, AP start) during a real bring-up bug, with nothing in
# the log to show for it. Revisit once things are actually working and
# binary size matters more than visibility.

# Required for AP-mode WiFi provisioning - off by default in ESP-IDF
CONFIG_ESP_WIFI_SOFTAP_SUPPORT=y

# Browsers open several parallel connections to the setup/admin page and to
# the MJPEG stream; default (10) can starve requests under real use.
CONFIG_LWIP_MAX_SOCKETS=16
```

## sdkconfig.defaults.esp32
```kconfig
# AI-Thinker ESP32-CAM (plain ESP32, 4MB flash/PSRAM)
CONFIG_PARTITION_TABLE_CUSTOM_FILENAME="partitions-4m.csv"
CONFIG_ESPTOOLPY_FLASHSIZE_4MB=y
```

## sdkconfig.defaults.esp32s3
```kconfig
# Flash size isn't uniform across esp32s3 boards (Freenove: 16MB, nulllab
# ESP32-S3-CAM: 8MB per its ZB25VQ64 flash chip - real hardware boot-looped
# with "Detected size(8192k) smaller than the size in the binary image
# header(16384k)" until this was moved per-board). Board-specific settings
# (board select, flash size, and anything else that genuinely differs)
# live in board-configs/<board>.sdkconfig - see Makefile/CI workflows for
# how those get layered on top of this file via SDKCONFIG_DEFAULTS.
#
# partitions-8m.csv lays out 6MB of whatever's actually on the chip - fine
# on both 8MB and 16MB boards, just leaves the top half unused on Freenove.
CONFIG_PARTITION_TABLE_CUSTOM_FILENAME="partitions-8m.csv"
CONFIG_SPIRAM=y
CONFIG_SPIRAM_MODE_OCT=y

# Tried CONFIG_ESP_DEFAULT_CPU_FREQ_MHZ_240 (up from ESP-IDF's stock
# 160MHz) on the theory that software JPEG encode is our CPU-bound
# bottleneck. Real hardware data said otherwise: 50 /snapshot samples at
# 240MHz averaged ~1.1s (worst case 4.2s) vs. ~0.52s at stock 160MHz
# (worst case 1.83s) - consistent across three separate batches, not
# noise. No known mechanism explains it (camera peripheral clock is a
# separate fixed 80MHz APB bus, shouldn't care about CPU frequency) -
# leading theory is 240MHz plus WIFI_PS_NONE together raise average
# current draw enough to matter even on a "good" PSU. Left at stock.

# CONFIG_CAMERA_PSRAM_DMA intentionally left at its default (off). It was
# tried here to chase "NO-SOI"/"EV-EOF-OVF" errors, but that turned out to
# be a transposed D5/D7 pin (fixed in boards/freenove_s3.h) - the real
# bug. Once pins were correct, PSRAM DMA mode caused a *different*
# failure ("NO-EOI" + capture timeout, at both HD and VGA - not a
# resolution/bandwidth issue). Turns out this is a known, acknowledged
# limitation, not something to debug further here: per esp32-camera
# maintainers (github.com/espressif/esp32-camera/issues/775), "It does
# not work well for JPEG... Overall experimental feature" - multiple
# unresolved upstream bugs (#783, #785, #776) chase EOI-detection
# failures specifically in this mode. Leave off; it was never the fix.
```
